## config/boards/shields/charybdis/Kconfig.defconfig
```kconfig
if SHIELD_CHARYBDIS_RIGHT

config PMW3610
    bool "PMW3610 compatibility"
    default y
    select PMW3610_ALT

config PMW3610_REST1_SAMPLE_TIME_MS
    int "PMW3610 REST1 sample time (ms)"
    default 100

config PMW3610_REST2_SAMPLE_TIME_MS
    int "PMW3610 REST2 sample time (ms)"
    default 200

config PMW3610_REST3_SAMPLE_TIME_MS
    int "PMW3610 REST3 sample time (ms)"
    default 300

config PMW3610_RUN_DOWNSHIFT_TIME_MS
    int "PMW3610 run downshift time (ms)"
    default 500

config PMW3610_REST1_DOWNSHIFT_TIME_MS
    int "PMW3610 REST1 downshift time (ms)"
    default 3000

config PMW3610_REST2_DOWNSHIFT_TIME_MS
    int "PMW3610 REST2 downshift time (ms)"
    default 30000

endif
```

## config/west.yml
```yaml
manifest:
  defaults:
    revision: v0.3
  remotes:
    - name: zmkfirmware
      url-base: https://github.com/zmkfirmware
    - name: badjeff
      url-base: https://github.com/badjeff
    - name: bastardkb
      url-base: https://github.com/bastardkb
    # Additional modules containing boards/shields/custom code can be listed here as well
    # See https://docs.zephyrproject.org/3.2.0/develop/west/manifest.html#projects
  projects:
    - name: zmk
      remote: zmkfirmware
      import: app/west.yml
    - name: zmk-pmw3610-driver
      remote: badjeff
      revision: main
      path: modules/zmk-pmw3610-driver
    - name: zmk-keyboards-charybdis
      url: https://github.com/victorlucachi/zmk-keyboards-charybdis
      revision: main
      path: modules/zmk-keyboards-charybdis
  self:
    path: config
```
